/* 
 * Project pong
 * Author: Jamie Dowden-Duarte
 * Date: 6/25/25
 * For comprehensive documentation and examples, please visit:
 * https://docs.particle.io/firmware/best-practices/firmware-template/
 */

#include "Particle.h"
#include "Adafruit_GFX.h"
#include "Adafruit_SSD1306.h"
#include "Encoder.h"
#include "IoTClassroom_CNM.h"

SYSTEM_MODE(SEMI_AUTOMATIC);

const int OLED_RESET=-1;
int movement = 128, carCation, carCation2, score = 0, movement2 = 128;
int spawn, spawnmovement = 128, highscore = 0, P2L, P2R, randy = random(0,64);
int speed = 1, carRight, randyspawn, storm, SC = 0, carLeft, PLAYERCOUNT = 3;
int milesLeft = 50, hitprog1, hitprog2, P1prog = 1, P2prog = 2, centerOb, centerItem;


Adafruit_SSD1306 display(OLED_RESET);
IoTTimer myTimer;
Encoder myEnc (D8,D9);
Encoder Player2(D5,D6);
Button P1B(D3);
Button P2B(D7);

#define XPOS 0
#define YPOS 1
#define DELTAY 2
#if (SSD1306_LCDHEIGHT != 64)
#error ("fix yo stuff");
#endif

const unsigned char P2 [] PROGMEM = {
	0x00, 0x00, 0x00, 0x00, 0x00, 0x00, 0x00, 0x00, 0x00, 0x00, 0x00, 0x00, 0x3f, 0xff, 0x80, 0x65, 
	0xce, 0x40, 0x56, 0x33, 0x60, 0x02, 0x22, 0x20, 0x22, 0x26, 0x20, 0x22, 0x20, 0x20, 0x02, 0x24, 
	0x20, 0x12, 0x26, 0x20, 0x01, 0x02, 0x20, 0x3f, 0xb1, 0x20, 0x52, 0x84, 0x60, 0x3f, 0xff, 0x80, 
	0x00, 0x00, 0x00, 0x00, 0x00, 0x00, 0x00, 0x00, 0x00, 0x00, 0x00, 0x00
};

const unsigned char Gun [] PROGMEM = {
	0x00, 0x00, 0x00, 0x00, 0x00, 0x00, 0x00, 0x00, 0x00, 0x7e, 0x3f, 0xc0, 0x7f, 0xff, 0xc0, 0x7f, 
	0xff, 0xe0, 0x7f, 0xff, 0xe0, 0x7f, 0xff, 0xe0, 0x04, 0xdf, 0x80, 0x04, 0x5f, 0x00, 0x04, 0x1f, 
	0x80, 0x03, 0xdf, 0xc0, 0x00, 0x0f, 0xc0, 0x00, 0x0f, 0xc0, 0x00, 0x0f, 0xc0, 0x00, 0x07, 0xe0, 
	0x00, 0x07, 0xe0, 0x00, 0x07, 0x00, 0x00, 0x00, 0x00, 0x00, 0x00, 0x00
};

const unsigned char Paw [] PROGMEM = {
	0x00, 0x00, 0x00, 0x00, 0x00, 0x00, 0x00, 0x00, 0x00, 0x07, 0xfc, 0x00, 0x07, 0xff, 0x00, 0x01, 
	0xe3, 0xc0, 0x2f, 0x80, 0xc0, 0x2f, 0x3e, 0x60, 0x03, 0x63, 0x60, 0x1f, 0xe3, 0xe0, 0x1f, 0xe3, 
	0xe0, 0x03, 0x63, 0x60, 0x03, 0x3e, 0x60, 0x01, 0x80, 0xc0, 0x01, 0xe3, 0xc0, 0x00, 0x7f, 0x00, 
	0x00, 0x1c, 0x00, 0x00, 0x00, 0x00, 0x00, 0x00, 0x00, 0x00, 0x00, 0x00
};

const unsigned char obstacle [] PROGMEM = {
	0x00, 0x00, 0xff, 0xc0, 0xff, 0xc0, 0x00, 0x00, 0xff, 0xc0, 0x00, 0x00, 0xff, 0xc0, 0xff, 0xc0, 
	0x00, 0x00, 0xff, 0xc0, 0x00, 0x00, 0xff, 0xc0, 0xff, 0xc0, 0x00, 0x00, 0xff, 0xc0, 0x00, 0x00, 
	0xff, 0xc0, 0xff, 0xc0, 0x00, 0x00, 0xff, 0xc0
};

const unsigned char car [] PROGMEM = {
	0x00, 0x00, 0x00, 0x00, 0x00, 0x00, 0x00, 0x00, 0x00, 0x00, 0x00, 0x00, 0x1f, 0xf7, 0x80, 0x44, 
	0x04, 0x40, 0x1f, 0xb3, 0x20, 0x00, 0x02, 0x20, 0x20, 0x06, 0x20, 0x20, 0x00, 0x20, 0x00, 0x04, 
	0x20, 0x00, 0x04, 0x20, 0x00, 0x02, 0x20, 0x1f, 0xb1, 0x20, 0x40, 0x80, 0x40, 0x3f, 0xff, 0x80, 
	0x00, 0x00, 0x00, 0x00, 0x00, 0x00, 0x00, 0x00, 0x00, 0x00, 0x00, 0x00
};

const unsigned char road [] PROGMEM = {
	0x00, 0x00, 0x00, 0x00, 0x00, 0x00, 0x00, 0x00, 0x00, 0x00, 0x00, 0x00, 0x00, 0x00, 0x00, 0x00, 
	0x00, 0x00, 0x00, 0x00, 0x00, 0x00, 0x00, 0x00, 0x00, 0x00, 0x00, 0x00, 0x00, 0x00, 0x00, 0x00, 
	0x00, 0x00, 0x00, 0x00, 0x00, 0x00, 0x00, 0x00, 0x00, 0x00, 0x00, 0x00, 0x00, 0x00, 0x00, 0x00, 
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	0x00, 0x00, 0x00, 0x00, 0x00, 0x00, 0x00, 0x00, 0x00, 0x00, 0x00, 0x00, 0x00, 0x00, 0x00, 0x00
};



void setup() {
  pinMode(D3,INPUT_PULLDOWN);
  pinMode(D7,INPUT_PULLDOWN);
  Serial.begin(9600);
  waitFor(Serial.isConnected,10000);
  display.begin(SSD1306_SWITCHCAPVCC, 0x3C);
  display.display();
  delay(2000);
  display.clearDisplay();
  display.printf("LEFT FOR 1P, RiGHT FOR 2P\n\n\n\n");
  display.display();
  
  display.setTextSize(1);
  display.setTextColor(WHITE);
  myTimer.startTimer(10);
  
  display.printf("LEFT FOR 1P, RiGHT FOR 2P\n\n\n\n");
  display.display();
}

void loop() {
  if (P1B.isClicked()){
    PLAYERCOUNT = 0;
  }
  if (P2B.isClicked()){
    PLAYERCOUNT = 1;
  }
  if (P2B.isClicked() && P1B.isPressed()){
    PLAYERCOUNT = 4;
  }
  if(PLAYERCOUNT == 0){
    pinMode(D5,OUTPUT);
carCation = myEnc.read();
if(carCation >= 54){
  myEnc.write(54);
}
if(carCation <= -10){
  myEnc.write(-10);
}

carCation = myEnc.read();
  display.clearDisplay();
  display.setCursor(0,0);
  if(storm == 2 && SC == 0){
    SC ++;
    speed -=2;
  }
      if(SC>0){
    display.printf("   A STORM APPROACHES");
    display.display();
    }
  if(spawn == 2){
  display.drawBitmap(movement,randyspawn,Paw,20,20,1);
  }
  display.drawBitmap(1,1,road,128,64,1);
  display.drawBitmap(1,carCation,car,20,20,1);
  display.drawBitmap(movement,randy,obstacle,10,20,1);
  display.display();
  carLeft = carCation;
  carRight = carCation+20;
  centerOb = randy + 10;
  centerItem = randyspawn +10;
  if (movement <=5 && centerOb <= carRight && centerOb >= carLeft){
    if(score > highscore){
      highscore = score;
    }
    
  display.clearDisplay();
  display.printf("GAME OVER\nSCORE:%d\nHIGHSCORE:%d\n",score,highscore);
  display.display();
  movement = 128;
  speed = random(12);
  randy = random(64);
  delay(5000);  
  score = 0;
  speed = 1;
  }
  if (movement ==5 && centerItem <= carRight && centerItem >= carLeft){
    score +=10;
    speed +=5;
    }

  if(movement <= -5){
    SC = 0;
    movement = 128;
    speed ++;
    randy = random(64);
    spawn = random(5);
    randyspawn = random(64);
    storm = random(30);
    spawnmovement = 128;
    score ++;
  }

  if(myTimer.isTimerReady()){
    movement -=speed;
    spawnmovement -=speed;
    myTimer.startTimer(10);
  }
  if(speed <= 0){
    speed = 1;
  }
}









if(PLAYERCOUNT == 1){
  carCation = myEnc.read();
  if(carCation >= 54){
    myEnc.write(54);
  }
  if(carCation <= -10){
    myEnc.write(-10);
  }
  carCation2 = Player2.read();
  if(carCation2 >= 54){
    Player2.write(54);
  }
  if(carCation2 <= -10){
    Player2.write(-10);
  }
  carCation = myEnc.read();
  carCation2 = Player2.read();
    display.clearDisplay();
    display.setCursor(0,0);
    if(storm == 2 && SC == 0){
      SC ++;
      speed --;
    }
        if(SC>0){
      display.printf("   A STORM APPROACHES");
      display.display();
      }
    if(spawn == 2){
    display.drawBitmap(movement,randyspawn,Gun,20,20,1);
    }
    display.printf("Miles Left:%d\n",milesLeft);
    display.drawBitmap(1,1,road,128,64,1);
    display.drawBitmap(P1prog,carCation,car,20,20,1);
    display.drawBitmap(P2prog,carCation2,P2,20,20,1);
    display.drawBitmap(movement,randy,obstacle,10,20,1);
    display.display();
    carLeft = carCation;
    carRight = carCation+20;
    P2L = carCation2;
    P2R = carCation2+20;
    hitprog1 = P1prog-5;
    hitprog2 = P2prog-5;
    centerOb = randy+15;
    centerItem = randyspawn+5;
    if (movement <=P1prog && movement >= hitprog1 && centerOb <= carRight && centerOb >= carLeft){
      P1prog=-10;
    }
    if (movement <=P1prog && movement >= hitprog1 && centerItem <= carRight && centerItem >= carLeft){
      P1prog=+20;
      }
      if (movement <=P2prog && movement >= hitprog2 && centerOb <= P2R && centerOb >= P2L){
        P2prog=-10;
      }
      if (movement <=P2prog && movement >= hitprog2 && centerItem <= P2R && centerItem >= P2L){
        P2prog=+20;
        }
        if(milesLeft == 0){
          if (P1prog>P2prog){
            display.clearDisplay();
            display.printf("P1 WIN");
            display.display();
            delay(5000);
            milesLeft = 50;
            P1prog = 1;
            P2prog = 1;
            speed = 5;
          }
          else{
            display.clearDisplay();
            display.printf("P2 WIN");
            display.display();
            delay(5000);
            milesLeft = 50;
            P1prog = 1;
            P2prog = 1;

          }
        }
  
    if(movement <= -5){
      SC = 0;
      P1prog ++;
      milesLeft--;
      P2prog ++;
      speed++;
      movement = 128;
      randy = random(64);
      spawn = random(5);
      randyspawn = random(64);
      storm = random(50);
      spawnmovement = 128;
    }
  
    if(myTimer.isTimerReady()){
      movement -=speed;
      spawnmovement -=speed;
      myTimer.startTimer(10);
    }
    if(speed < 5){
      speed = 5;
    }
    if(speed>20){
      speed = 20;
    }
  }







  if(PLAYERCOUNT == 4){
    carCation = myEnc.read();
    if(carCation >= 54){
      myEnc.write(54);
    }
    if(carCation <= -10){
      myEnc.write(-10);
    }
    carCation2 = Player2.read();
    if(carCation2 >= 54){
      Player2.write(54);
    }
    if(carCation2 <= -10){
      Player2.write(-10);
    }
    carCation = myEnc.read();
    carCation2 = Player2.read();
      display.clearDisplay();
      display.setCursor(0,0);
      if(storm == 2 && SC == 0){
        SC ++;
        speed --;
      }
          if(SC>0){
        display.printf("   A STORM APPROACHES");
        display.display();
        }
      if(spawn == 2){
      display.drawBitmap(movement,randyspawn,Paw,20,20,1);
      }
      display.printf("Miles Left:%d\n",milesLeft);
      display.drawBitmap(1,1,road,128,64,1);
      display.drawBitmap(1,carCation,car,20,20,1);
      display.drawBitmap(1,carCation2,P2,20,20,1);
      display.drawBitmap(movement,randy,obstacle,10,20,1);
      display.display();
      carLeft = carCation;
      carRight = carCation+20;
      P2L = carCation2;
      P2R = carCation2+20;
      hitprog1 = P1prog-5;
      hitprog2 = P2prog-5;
      centerOb = randy+15;
      centerItem = randyspawn+5;
      if (movement <=5 && centerOb <= carRight && centerOb >= carLeft){
        P1prog=-10;
      }
      if (movement <=5 && centerItem <= carRight && centerItem >= carLeft){
        P1prog=+20;
        }
        if (movement <=5 && centerOb <= P2R && centerOb >= P2L){
          P2prog=-10;
        }
        if (movement <=5 && centerItem <= P2R && centerItem >= P2L){
          P2prog=+20;
          }
          if(milesLeft == 0){
            if (P1prog>P2prog){
              display.clearDisplay();
              display.printf("P1 WIN");
              display.display();
              delay(5000);
              milesLeft = 50;
              P1prog = 1;
              P2prog = 1;
              speed = 5;
            }
            else{
              display.clearDisplay();
              display.printf("P2 WIN");
              display.display();
              delay(5000);
              milesLeft = 50;
              P1prog = 1;
              P2prog = 1;
  
            }
          }
    
      if(movement <= -5){
        SC = 0;
        P1prog ++;
        milesLeft--;
        P2prog ++;
        speed++;
        movement = 128;
        randy = random(64);
        spawn = random(5);
        randyspawn = random(64);
        storm = random(50);
        spawnmovement = 128;
      }
    
      if(myTimer.isTimerReady()){
        movement -=speed;
        spawnmovement -=speed;
        myTimer.startTimer(10);
      }
      if(speed < 5){
        speed = 5;
      }
      if(speed>20){
        speed = 20;
      }
    }
}